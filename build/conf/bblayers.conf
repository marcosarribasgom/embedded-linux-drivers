## build/conf/bblayers.conf
```bitbake
# POKY_BBLAYERS_CONF_VERSION is increased each time build/conf/bblayers.conf
# changes incompatibly
POKY_BBLAYERS_CONF_VERSION = "2"

BBPATH = "${TOPDIR}"
BBFILES ?= ""

BBLAYERS ?= " \
  /home/student/19/poky/meta \
  /home/student/19/poky/meta-poky \
  /home/student/19/poky/meta-yocto-bsp \
  /home/student/19/meta-xilinx/meta-xilinx-bsp \
  /home/student/19/meta-xilinx/meta-xilinx-contrib \
  /home/student/19/meta-pynq \
  /home/student/19/meta-group19 \
  /home/student/19/meta-compce460 \
  "
```
